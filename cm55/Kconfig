## cm55/Kconfig
```kconfig
mainmenu "RT-Thread Configuration"

config BSP_DIR
    string
    option env="BSP_ROOT"
    default "."

config RTT_DIR
    string
    option env="RTT_ROOT"
    default "rt-thread"

config PKGS_DIR
    string
    option env="PKGS_ROOT"
    default "packages"

config ENV_DIR
    string
    option env="ENV_ROOT"
    default "/"

source "$RTT_DIR/Kconfig"
source "packages/ProjectKconfig"
source "$RTT_DIR/../libraries/M55_Config/Kconfig"
source "$RTT_DIR/../libraries/components/CherryUSB-1.6.0/Kconfig.rtt"
```
